## arch/arm/mach-rockchip/rk3568/Kconfig
```kconfig
if ROCKCHIP_RK3568

config TARGET_EVB_RK3568
	bool "RK3568 evaluation board"
	select BOARD_LATE_INIT
	help
	  RK3568 EVB is a evaluation board for Rockchp RK3568.

config TARGET_NANOPI5
    bool "FriendlyElec NanoPi 5 Series"
    select BOARD_LATE_INIT
    select VENDOR_FRIENDLYELEC
    help
      Support for FriendlyElec boards based on RK3568.

config ROCKCHIP_BOOT_MODE_REG
	default 0xfdc20200

config ROCKCHIP_STIMER_BASE
	default 0xfdd1c020

config SYS_SOC
	default "rk3568"

config SYS_MALLOC_F_LEN
	default 0x2000

source "board/rockchip/evb_rk3568/Kconfig"
source board/rockchip/nanopi5/Kconfig

endif
```

## arch/arm/mach-rockchip/rk3588/Kconfig
```kconfig
if ROCKCHIP_RK3588

config TARGET_RK3588_NEU6
	bool "Edgeble Neural Compute Module 6(Neu6) SoM"
	select BOARD_LATE_INIT
	help
	  Neu6:
	  Neural Compute Module 6A(Neu6a) is a 96boards SoM-CB compute module
	  based on Rockchip RK3588 from Edgeble AI.

	  Neu6-IO:
	  Neural Compute Module 6(Neu6) IO board is an industrial form factor
	  IO board and Neu6a needs to mount on top of this IO board in order to
	  create complete Edgeble Neural Compute Module 6(Neu6) IO platform.

config TARGET_ROCK5B_RK3588
	bool "Radxa ROCK5B RK3588 board"
	select BOARD_LATE_INIT
	help
	  Radxa ROCK5B is a Rockchip RK3588 based SBC (Single Board Computer)
	  by Radxa.

	  There are tree variants depending on the DRAM size : 4G, 8G and 16G.

	  Specification:

	  Rockchip Rk3588 SoC
	  4x ARM Cortex-A76, 4x ARM Cortex-A55
	  4/8/16GB memory LPDDR4x
	  Mali G610MC4 GPU
	  MIPI CSI 2 multiple lanes connector
	  eMMC module connector
	  uSD slot (up to 128GB)
	  2x USB 2.0, 2x USB 3.0
	  2x HDMI output, 1x HDMI input
	  Ethernet port
	  40-pin IO header including UART, SPI, I2C and 5V DC power in
	  USB PD over USB Type-C
	  Size: 85mm x 54mm


config TARGET_NANOPI6
    bool "FriendlyElec NanoPi 6 Series"
    select BOARD_LATE_INIT
    select VENDOR_FRIENDLYELEC
    help
      Support for FriendlyElec boards based on RK3588.

	  Specification:
        SoC: Rockchip RK3588S
            CPU: Quad-core ARM Cortex-A76(up to 2.4GHz) and quad-core Cortex-A55 CPU (up to 1.8GHz)
            GPU: Mali-G610 MP4, compatible with OpenGLES 1.1, 2.0, and 3.2, OpenCL up to 2.2 and Vulkan1.2
            VPU: 8K@60fps H.265 and VP9 decoder, 8K@30fps H.264 decoder, 
                 4K@60fps AV1 decoder, 8K@30fps H.264 and H.265 encoder
            NPU: 6TOPs, supports INT4/INT8/INT16/FP16
        RAM: 64-bit 8GB LPDDR4X at 2133MHz
        Flash: 32GB eMMC, at HS400 mode
        Ethernet: one Native Gigabit Ethernet, and two PCIe 2.5G Ethernet
        USB: one USB 3.0 Type-A and one USB 2.0 Type-A
        HDMI:
            compatible with HDMI2.1, HDMI2.0, and HDMI1.4 operation
            support up to 7680x4320@60Hz
            Support RGB/YUV(up to 10bit) format
        microSD: support up to SDR104 mode
        GPIO:
            12-pin 0.5mm FPC connector
            with up to 1x SPI, up to 3x UARTs, up to 1x I2Cs, up to 2x SPDIF, up to 8x GPIOs
        Debug: one Debug UART, 3 Pin 2.54mm header, 3.3V level, 1500000bps
        LEDs: 4 x GPIO Controlled LED (SYS, WAN, LAN1, LAN2)
        others:
        2 Pin 1.27/1.25mm RTC battery input connector for low power RTC IC HYM8563TS
        one IR receiver and the carrier frequency is 38Khz
        MASK button for eMMC update
        one user button
        one 5V Fan connector
        Power supply: USB-C, support PD, 5V/9V/12V/20V input
        PCB: 8 Layer, 62x90x1.6mm
        Ambient Operating Temperature: 0℃ to 70℃

config ROCKCHIP_BOOT_MODE_REG
	default 0xfd588080

config ROCKCHIP_STIMER_BASE
	default 0xfd8c8000

config SYS_SOC
    default "rk3588"

    config SYS_MALLOC_F_LEN
        default 0x400

    source board/edgeble/neural-compute-module-6/Kconfig
    source board/radxa/rock5b-rk3588/Kconfig
    source board/rockchip/nanopi6/Kconfig

endif
```

## board/friendlyelec/nanopc-rk3588/Kconfig
```kconfig
if TARGET_NANOPC_RK3588

config SYS_BOARD
	default "nanopc-rk3588"

config SYS_VENDOR
	default "friendlyelec"

config SYS_CONFIG_NAME
	default "nanopc-rk3588"

config BOARD_SPECIFIC_OPTIONS # dummy
	def_bool y

endif
```

## board/friendlyelec/nanopi-rk3588s/Kconfig
```kconfig
if TARGET_NANOPI_RK3588

config SYS_BOARD
	default "nanopi-rk3588s"

config SYS_VENDOR
	default "friendlyelec"

config SYS_CONFIG_NAME
	default "nanopi-rk3588s"

config BOARD_SPECIFIC_OPTIONS # dummy
	def_bool y

endif
```

## board/friendlyelec/nanopi6-rk3588/Kconfig
```kconfig
if TARGET_NANOPI6_RK3588

config SYS_BOARD
	default "nanopi6-rk3588"

config SYS_VENDOR
	default "friendlyelec"

config SYS_CONFIG_NAME
	default "nanopi6-rk3588"

config BOARD_SPECIFIC_OPTIONS # dummy
	def_bool y

endif
```

## board/rockchip/nanopi6/Kconfig
```kconfig
if TARGET_NANOPI6

config SYS_BOARD
	default "nanopi6"

config SYS_VENDOR
	default "rockchip"

config SYS_CONFIG_NAME
	default "nanopi6-rk3588"

config BOARD_SPECIFIC_OPTIONS
	def_bool y

endif
```

## configs/nanopi6-rk3588_defconfig
```kconfig
CONFIG_ARM=y
CONFIG_SKIP_LOWLEVEL_INIT=y
CONFIG_SYS_HAS_NONCACHED_MEMORY=y
CONFIG_COUNTER_FREQUENCY=24000000
CONFIG_ARCH_ROCKCHIP=y
CONFIG_TEXT_BASE=0x00a00000
CONFIG_SPL_LIBCOMMON_SUPPORT=y
CONFIG_SPL_LIBGENERIC_SUPPORT=y
CONFIG_NR_DRAM_BANKS=2
CONFIG_HAS_CUSTOM_SYS_INIT_SP_ADDR=y
CONFIG_CUSTOM_SYS_INIT_SP_ADDR=0xc00000
CONFIG_ENV_SIZE=0x1f000
CONFIG_DEFAULT_DEVICE_TREE="rk3588-nanopi6"
CONFIG_ROCKCHIP_RK3588=y
CONFIG_SPL_ROCKCHIP_COMMON_BOARD=y
CONFIG_ROCKCHIP_BOOT_MODE_REG=0
CONFIG_SPL_SERIAL=y
CONFIG_SPL_STACK_R_ADDR=0x600000
CONFIG_TARGET_NANOPI6_RK3588=y
CONFIG_SPL_STACK=0x400000
CONFIG_DEBUG_UART_BASE=0xFEB50000
CONFIG_DEBUG_UART_CLOCK=24000000
CONFIG_SYS_LOAD_ADDR=0xc00800
CONFIG_PCI=y
CONFIG_DEBUG_UART=y
CONFIG_FIT=y
CONFIG_FIT_VERBOSE=y
CONFIG_SPL_FIT_SIGNATURE=y
CONFIG_SPL_LOAD_FIT=y
CONFIG_BOOTSTD_FULL=y
CONFIG_SPL_BOOTSTD=y
# CONFIG_BOOTSTD_DEFAULTS is not set
CONFIG_BOOTSTD_BOOTCOMMAND=y
# CONFIG_BOOTMETH_EFILOADER is not set
# CONFIG_BOOTMETH_VBE_REQUEST is not set
# CONFIG_BOOTMETH_VBE_SIMPLE is not set
# CONFIG_BOOTMETH_VBE_SIMPLE_OS is not set
# CONFIG_BOOTMETH_SCRIPT is not set
CONFIG_OF_BOARD_SETUP=y
CONFIG_DISTRO_DEFAULTS=y
CONFIG_SD_BOOT=y
CONFIG_DEFAULT_FDT_FILE="rockchip/rk3588-nanopi6.dtb"
CONFIG_LOGLEVEL=6
# CONFIG_DISPLAY_CPUINFO is not set
# CONFIG_DISPLAY_BOARDINFO is not set
CONFIG_DISPLAY_BOARDINFO_LATE=y
CONFIG_SPL_MAX_SIZE=0x40000
CONFIG_SPL_PAD_TO=0x7f8000
CONFIG_SPL_HAS_BSS_LINKER_SECTION=y
CONFIG_SPL_BSS_START_ADDR=0x4000000
CONFIG_SPL_BSS_MAX_SIZE=0x4000
# CONFIG_SPL_RAW_IMAGE_SUPPORT is not set
# CONFIG_SPL_SHARES_INIT_SP_ADDR is not set
CONFIG_SPL_STACK_R=y
CONFIG_SPL_CPU=y
CONFIG_SPL_I2C=y
CONFIG_SPL_PCI=y
CONFIG_SPL_DM_RESET=y
CONFIG_SPL_RTC=y
CONFIG_SPL_ATF=y
CONFIG_CMD_TLV_EEPROM=y
CONFIG_SPL_CMD_TLV_EEPROM=y
# CONFIG_BOOTM_NETBSD is not set
# CONFIG_BOOTM_PLAN9 is not set
# CONFIG_BOOTM_RTEMS is not set
# CONFIG_CMD_VBE is not set
# CONFIG_BOOTM_VXWORKS is not set
CONFIG_CMD_BOOTMENU=y
CONFIG_CMD_ADC=y
CONFIG_CMD_GPIO=y
CONFIG_CMD_GPT=y
CONFIG_CMD_MMC=y
CONFIG_CMD_PCI=y
CONFIG_CMD_SPI=y
CONFIG_CMD_USB=y
# CONFIG_CMD_SETEXPR is not set
# CONFIG_CMD_DATE is not set
CONFIG_CMD_REGULATOR=y
CONFIG_MMC_SPEED_MODE_SET=y
# CONFIG_SPL_DOS_PARTITION is not set
CONFIG_SPL_OF_CONTROL=y
CONFIG_OF_LIVE=y
CONFIG_OF_SPL_REMOVE_PROPS="clock-names interrupt-parent power-domains assigned-clocks assigned-clock-rates assigned-clock-parents"
CONFIG_OVERWRITE_ETHADDR_ONCE=y
CONFIG_ENV_IS_IN_MMC=y
CONFIG_NET_RANDOM_ETHADDR=y
CONFIG_IPV6=y
CONFIG_SPL_DM_DEVICE_REMOVE=y
CONFIG_SPL_REGMAP=y
CONFIG_SPL_SYSCON=y
CONFIG_SARADC_ROCKCHIP_V2=y
CONFIG_BLKMAP=y
CONFIG_SPL_CLK=y
CONFIG_CPU=y
CONFIG_ROCKCHIP_GPIO=y
CONFIG_SYS_I2C_ROCKCHIP=y
CONFIG_MISC=y
CONFIG_I2C_EEPROM=y
CONFIG_SPL_I2C_EEPROM=y
CONFIG_SYS_I2C_EEPROM_ADDR=0x0
CONFIG_SUPPORT_EMMC_RPMB=y
CONFIG_MMC_HS400_ES_SUPPORT=y
CONFIG_SPL_MMC_HS400_ES_SUPPORT=y
CONFIG_MMC_HS400_SUPPORT=y
CONFIG_SPL_MMC_HS400_SUPPORT=y
CONFIG_MMC_DW=y
CONFIG_MMC_DW_ROCKCHIP=y
CONFIG_MMC_SDHCI=y
CONFIG_MMC_SDHCI_ROCKCHIP=y
CONFIG_SPI_FLASH_MACRONIX=y
CONFIG_PHY_REALTEK=y
CONFIG_RTL8211X_PHY_FORCE_MASTER=y
CONFIG_RTL8211F_PHY_FORCE_EEE_RXC_ON=y
CONFIG_RTL8201F_PHY_S700_RMII_TIMINGS=y
CONFIG_DM_ETH_PHY=y
CONFIG_DWC_ETH_QOS=y
CONFIG_DWC_ETH_QOS_ROCKCHIP=y
CONFIG_RTL8169=y
CONFIG_PCIE_DW_ROCKCHIP=y
CONFIG_PHY_ROCKCHIP_INNO_DSIDPHY=y
CONFIG_PHY_ROCKCHIP_INNO_USB2=y
CONFIG_PHY_ROCKCHIP_NANENG_COMBOPHY=y
CONFIG_PHY_ROCKCHIP_PCIE=y
CONFIG_SPL_PINCTRL=y
CONFIG_REGULATOR_PWM=y
CONFIG_PWM_ROCKCHIP=y
CONFIG_SPL_RAM=y
CONFIG_ROCKCHIP_SDRAM_COMMON=y
# CONFIG_RAM_ROCKCHIP_DEBUG is not set
CONFIG_RAM_ROCKCHIP_LPDDR4=y
CONFIG_DM_RNG=y
CONFIG_RNG_ROCKCHIP=y
CONFIG_DM_RTC=y
CONFIG_SPL_DM_RTC=y
CONFIG_RTC_ENABLE_32KHZ_OUTPUT=y
CONFIG_BAUDRATE=1500000
CONFIG_DEBUG_UART_SHIFT=2
CONFIG_DEBUG_UART_ANNOUNCE=y
CONFIG_SYS_NS16550_MEM32=y
CONFIG_ROCKCHIP_SFC=y
CONFIG_SYSRESET=y
CONFIG_USB=y
CONFIG_USB_EHCI_HCD=y
CONFIG_USB_EHCI_GENERIC=y
CONFIG_USB_OHCI_HCD=y
CONFIG_USB_OHCI_GENERIC=y
CONFIG_USB_HOST_ETHER=y
CONFIG_USB_ETHER_ASIX=y
CONFIG_USB_ETHER_ASIX88179=y
CONFIG_USB_ETHER_MCS7830=y
CONFIG_USB_ETHER_RTL8152=y
CONFIG_USB_ETHER_SMSC95XX=y
# CONFIG_BINMAN_FDT is not set
CONFIG_ERRNO_STR=y
```

## configs/nanopi6_defconfig
```kconfig
CONFIG_ADC_KEY=y
CONFIG_ANDROID_AVB=y
CONFIG_ANDROID_BOOT_IMAGE_HASH=y
CONFIG_ANDROID_BOOTLOADER=y
CONFIG_ARCH_ROCKCHIP=y
CONFIG_ARM_CPU_SUSPEND=y
CONFIG_ARM=y
CONFIG_AVB_LIBAVB_AB=y
CONFIG_AVB_LIBAVB_ATX=y
CONFIG_AVB_LIBAVB_USER=y
CONFIG_AVB_LIBAVB=y
CONFIG_BAUDRATE=1500000
# CONFIG_BINMAN_FDT is not set
CONFIG_BOOTDELAY=0
CONFIG_CHARGE_ANIMATION=y
CONFIG_CHARGER_BQ25700=y
CONFIG_CHARGER_BQ25890=y
CONFIG_CLK_SCMI=y
CONFIG_CLK=y
CONFIG_CMD_BOOT_ANDROID=y
CONFIG_CMD_BOOT_ROCKCHIP=y
CONFIG_CMD_BOOTZ=y
CONFIG_CMD_DTIMG=y
# CONFIG_CMD_ELF is not set
# CONFIG_CMD_FLASH is not set
# CONFIG_CMD_FPGA is not set
CONFIG_CMD_GPT=y
# CONFIG_CMD_IMI is not set
# CONFIG_CMD_IMLS is not set
# CONFIG_CMD_ITEST is not set
# CONFIG_CMD_LOADB is not set
# CONFIG_CMD_LOADS is not set
# CONFIG_CMD_LZMADEC is not set
# CONFIG_CMD_MISC is not set
CONFIG_CMD_MMC=y
CONFIG_CMD_MTD_BLK=y
CONFIG_CMD_PCI=y
# CONFIG_CMD_SETEXPR is not set
CONFIG_CMD_SF=y
CONFIG_CMD_SPI=y
CONFIG_CMD_TFTP_BOOTM=y
CONFIG_CMD_TFTP_FLASH=y
CONFIG_CMD_TFTPPUT=y
# CONFIG_CMD_UNZIP is not set
CONFIG_CMD_USB_MASS_STORAGE=y
CONFIG_CMD_USB=y
# CONFIG_CMD_XIMG is not set
CONFIG_COUNTER_FREQUENCY=24000000
CONFIG_CUSTOM_SYS_INIT_SP_ADDR=0xc00000
CONFIG_DEBUG_UART_ANNOUNCE=y
CONFIG_DEBUG_UART_BASE=0xFEB50000
CONFIG_DEBUG_UART_CLOCK=24000000
CONFIG_DEBUG_UART_SHIFT=2
CONFIG_DEBUG_UART=y
CONFIG_DEFAULT_DEVICE_TREE="rk3588-nanopi6"
CONFIG_DEFAULT_FDT_FILE="rockchip/rk3588-nanopi6.dtb"
CONFIG_DISPLAY_BOARDINFO_LATE=y
# CONFIG_DISPLAY_CPUINFO is not set
CONFIG_DM_RESET=y
CONFIG_ERRNO_STR=y
CONFIG_ETH_DESIGNWARE=y
CONFIG_FIT_VERBOSE=y
CONFIG_FIT=y
CONFIG_GMAC_ROCKCHIP=y
CONFIG_HAS_CUSTOM_SYS_INIT_SP_ADDR=y
CONFIG_MISC=y
CONFIG_MMC_DW_ROCKCHIP=y
CONFIG_MMC_DW=y
CONFIG_MMC_SDHCI_ROCKCHIP=y
CONFIG_MMC_SDHCI_SDMA=y
CONFIG_MMC_SDHCI=y
CONFIG_NET_RANDOM_ETHADDR=y
CONFIG_NR_DRAM_BANKS=2
CONFIG_OF_BOARD_SETUP=y
CONFIG_OF_LIVE=y
CONFIG_OF_SPL_REMOVE_PROPS="pinctrl-0 pinctrl-names clock-names interrupt-parent assigned-clocks assigned-clock-rates assigned-clock-parents"
CONFIG_PWM_ROCKCHIP=y
CONFIG_REGULATOR_PWM=y
CONFIG_ROCKCHIP_GPIO=y
CONFIG_ROCKCHIP_RK3588=y
CONFIG_SKIP_LOWLEVEL_INIT=y
CONFIG_SPL_ATF=y
CONFIG_SPL_BSS_MAX_SIZE=0x4000
CONFIG_SPL_BSS_START_ADDR=0x4000000
CONFIG_SPL_CLK=y
# CONFIG_SPL_DOS_PARTITION is not set
CONFIG_SPL_FIT_SIGNATURE=y
CONFIG_SPL_HAS_BSS_LINKER_SECTION=y
CONFIG_SPL_LIBCOMMON_SUPPORT=y
CONFIG_SPL_LIBGENERIC_SUPPORT=y
CONFIG_SPL_LOAD_FIT=y
CONFIG_SPL_MAX_SIZE=0x20000
CONFIG_SPL_MMC=y
CONFIG_SPL_OF_CONTROL=y
CONFIG_SPL_PAD_TO=0x7f8000
CONFIG_SPL_RAM=y
# CONFIG_SPL_RAW_IMAGE_SUPPORT is not set
CONFIG_SPL_REGMAP=y
CONFIG_SPL_ROCKCHIP_BACK_TO_BROM=y
CONFIG_SPL_ROCKCHIP_COMMON_BOARD=y
CONFIG_SPL_SERIAL=y
# CONFIG_SPL_SHARES_INIT_SP_ADDR is not set
CONFIG_SPL_STACK=0x400000
CONFIG_SPL_STACK_R_ADDR=0x600000
CONFIG_SPL_STACK_R=y
CONFIG_SPL_SYSCON=y
CONFIG_SUPPORT_EMMC_RPMB=y
CONFIG_SYS_I2C_ROCKCHIP=y
CONFIG_SYS_LOAD_ADDR=0xc00800
CONFIG_SYSRESET=y
CONFIG_TARGET_NANOPI6=y
CONFIG_TEXT_BASE=0x00a00000
```
